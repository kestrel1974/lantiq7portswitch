## avm_cpmac/Kconfig
```kconfig
#
# AVM network configuration
#

config NET_VENDOR_AVM
	bool "AVM network devices and alternative drivers"
	default y
	---help---
	  If you are building a kernel for any current FRITZ!Box, you are
	  strongly encouraged to use the alternative AVM network drivers.

	  Note that the answer to this question doesn't directly affect the
	  kernel: saying N will just cause the configurator to skip all
	  the questions about AVM network drivers. If you say Y, you will be
	  asked for your specific card in the following questions.

if NET_VENDOR_AVM

config AVM_NETWORK_ENHANCEMENTS
	bool "AVM network enhancements"
	select AVM_PROM_ENVIRONMENT
	select AVM_RTNETLINK_ENHANCEMENT
	depends on AVM_SAMMEL
	help
	  Enables AVM kernel enhancements that are required for AVM cpmac, and
	  the AVM Sammeltreiber (avm_new).

config AVM_CPMAC
       tristate "AVM CPMAC support"
	depends on AVM_NETWORK_ENHANCEMENTS
       ---help---
         This driver is developed for the FRITZ!Box network hardware.
         To compile this driver as a module, choose M here.
         The module will be called 'avm_cpmac'.

config AVM_CPMAC_NUM_RX_BUFFERS
       int "Number of Rx-Buffers"
       depends on AVM_CPMAC
       default 256

config AVM_CPMAC_SWITCH
       bool "Support for switches (currently ADM6996 family)"
       depends on AVM_CPMAC
       default y
       help
         Code for the ADMtek switch family ADM6996 (L, LC, FC)

config AVM_CPMAC_ATH_PPA
    bool "Support PPA like functions for Atheros hardware"
    depends on AVM_CPMAC && ATHRS17_PHY && AVM_PA
    default n
    help
      Supports direct MAC routing in the switch

config AVM_CPMAC_ATH_PPA_HNAT
    bool "Support PPA like functions for HNAT on Atheros hardware"
    depends on AVM_CPMAC_ATH_PPA
    default n
    help
      Supports direct NAT routing in the switch

config AVM_SCATTER_GATHER
       bool "Scatter Gather DMA-TX Support for AVMNET"
       depends on AVM_CPMAC && (LANTIQ || ARCH_QCOM)
       default n

config AVM_TSO
       bool "AVMNET TCP Segmentation Offload"
       depends on AVM_SCATTER_GATHER && (ARCH_QCOM)
       default n

config AVM_UFO
       bool "AVMNET UDP Fragmentation Offload"
       depends on AVM_SCATTER_GATHER && (ARCH_QCOM)
       default n

config AVM_JUMBO
       bool "AVMNET JumboFrame support"
       depends on AVM_CPMAC && ARCH_QCOM
       default n

config AVMNET_DEBUG
       bool "AVMNET IFX Debug"
       depends on AVM_CPMAC && LANTIQ
       default n
       help
         Enable Debug-Proc-Interface /proc/eth/dbg for Lantiq CPUs"

config AVMNET_PROF_HOOKS
       bool "AVMNET SIMPLE PROFILING function hooks"
       depends on AVM_CPMAC && ARCH_QCOM && AVM_SIMPLE_PROFILING
       default n

config AVMNET_DEBUG_HAL
       bool "AVMNET HAL Debug"
       depends on AVM_CPMAC && LANTIQ
       default n
       help
         Enable HAL Debug for Lantiq Datapath Drivers"

config AVMNET_XMIT_DEBUG_BUFFER
       bool "avmnet xmit debug sysfs"
       depends on AVM_CPMAC
       default n

config LTQ_ETH_OAM
       tristate "Ethernet OAM handler"
       default n

config AVMNET_VLAN_MASTER
       bool "Create devices for port VLANs on ext. switch"
       depends on AVM_CPMAC
       default n

config AVMNET_VLAN_MASTER_STAG_8021Q
       bool "uses VLAN-STAG 8021Q instead of 8021AD"
       depends on AVM_CPMAC && AVMNET_VLAN_MASTER && (SOC_VR9 || ARCH_GEN3)
       default n

source "drivers/net/avm_cpmac/switch/ifx/Kconfig"
source "drivers/net/avm_cpmac/Kconfig.atheros"

endif # NET_VENDOR_AVM
```

## avm_cpmac/Kconfig.atheros
```kconfig
#
# Atheros device configuration (AVM avm_cpmac extension)
#

menuconfig NET_VENDOR_AVM_ATHEROS
	bool "Enable Atheros device support in avm_cpmac"
	default y
	depends on AVM_CPMAC
	---help---
	  Note that the answer to this question doesn't directly affect the
	  kernel: saying N will just cause the configurator to skip all
	  the questions about Atheros devices. If you say Y, you will be asked
	  for your specific card in the following questions.

if NET_VENDOR_AVM_ATHEROS

config AG7240
	tristate "Atheros AR7240 GigE"
	depends on SOC_AR71XX || SOC_AR724X || SOC_AR933X || SOC_AR934X || SOC_QCA955X
	help
	  This enables the building of Atheros AR7240 gigE driver module.

config AR7240_PLC_FILTER
	bool "Support power line filter"
	depends on AG7240

config FLOWMAC
	tristate "Atheros Flowcontrol For GigE and Wifi"
	depends on AG7240
	help
	  This enables the building of Flow control between AG7100 and Wifi.

config AR7240_S26_VLAN_IGMP
	bool "Support vlan and igmp functions in AR7240-S26 switch"
	depends on AG7240

config AR7240_S16_VLAN_IGMP
	bool "Support vlan and igmp functions in AR7240-S16 switch"
	depends on AG7240

config ATHEROS_HEADER_EN
	bool "Add two bytes atheros header before the ethernet packet."
	depends on AG7240

################################################################# 
config ATHRF2_PHY
	bool "Atheros F2 Phy"

config AR8033_PHY
	bool "Atheros AR8033 Phy"

	config ATHRS17_PHY
	bool "Atheros S17 external Phy"

config ATHRS27_PHY
	bool "Atheros S27 internal Phy"

config LANTIQ_11G_PHY
	bool "Lantiq 11G Phy"

config WLAN_OFFLOAD_PHY
	bool "WLAN Offload Phy"
	depends on LANTIQ

config ATH_PLC_PHY
	bool "PLC Phy"
	depends on ATH79

config SCRPN_TARGET_PHY
	bool "QCA Scorpion Target PHY"
	depends on ATH79

config DUMMY_PHY
	bool "Dummy Phy"
	---help---
	  Dummy phy that always got a link after poweron. Used to accomodate a
	  virtual avmnet device.

######################################################################
config ATHR_PHY_SWAP
	bool "Atheros PHY Swap "
	depends on SOC_AR934X

######################################################################
config AG7240_QOS
	bool "Enable MAC 0 QOS "
	depends on AG7240

config ATHRS_HW_NAT
	bool "Enable MAC 0 Egress and Ingress NAT engine "
	depends on AG7240

config ATHRS_HW_ACL
	bool "Enable MAC 0 Egress and Ingress ACL engine "
	depends on AG7240

endif # NET_VENDOR_AVM_ATHEROS

config IPQ806X_GMAC
	bool "QCA's IPQ806x GMAC support in avm_cpmac"
	depends on AVM_CPMAC && ARCH_QCOM
	select NET_VENDOR_AVM_ATHEROS
	select ATHRS17_PHY
	select ATHRF2_PHY
	help
	  Enable cpmac support for IPQ806x GMAC, used in Qualcomm Akronite.
```

## avm_cpmac/Kconfig.lantiq
```kconfig
#this file is included only if KERNEL_VERSION >= 3.10

if LANTIQ
source "drivers/net/ethernet/avm/avm_cpmac/switch/ifx/Kconfig"
endif
```
